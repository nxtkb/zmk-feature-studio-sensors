## Kconfig
```kconfig
# SPDX-License-Identifier: MIT
config NXTKB_STUDIO_SENSORS
    bool "Runtime Studio sensor bindings (NXTKB extension 0.1)"
    depends on ZMK_STUDIO_RPC
    help
      Enables runtime sensor editing for compatible clients. Requires this
      module's pinned integration patches; this is not an upstream protocol.

config NXTKB_STUDIO_SENSORS_MAX_SENSORS
    int "Maximum runtime sensor slots"
    depends on NXTKB_STUDIO_SENSORS
    range 1 16
    default 4
```

## dts/bindings/nxtkb,studio-sensors.yaml
```yaml
description: Local Studio sensor descriptors, in keymap sensor device order
compatible: "nxtkb,studio-sensors"
properties:
  sensor-ids:
    type: array
    required: true
  sensor-keys:
    type: string-array
    required: true
  sensor-names:
    type: string-array
    required: true
  sensor-kinds:
    type: array
    required: true
  press-positions:
    description: Stock key positions; 0xffffffff means no press association
    type: array
    required: true
```
